## boards/shields/zen/Kconfig.defconfig
```kconfig
if SHIELD_ZEN_LEFT || SHIELD_ZEN_RIGHT || SHIELD_ZEN_DONGLE

config ZMK_KEYBOARD_NAME
    default "ZEN"

config ZMK_SPLIT
    default y

config INPUT
    default y

config ZMK_MOUSE
    default y
endif

if SHIELD_ZEN_LEFT || SHIELD_ZEN_RIGHT

config SPI
    default y

endif

if SHIELD_ZEN_DONGLE

config ZMK_SPLIT_ROLE_CENTRAL
    default y

config ZMK_SPLIT_BLE_CENTRAL_PERIPHERALS
    default 2

# Two keyboard peripherals plus the five existing host profiles.
config BT_MAX_CONN
    default 7

config BT_MAX_PAIRED
    default 7

endif
```

## boards/shields/zen/Kconfig.shield
```kconfig
config SHIELD_ZEN_LEFT
    def_bool $(shields_list_contains,zen_left)

config SHIELD_ZEN_RIGHT
    def_bool $(shields_list_contains,zen_right)

config SHIELD_ZEN_DONGLE
    def_bool $(shields_list_contains,zen_dongle)
```
